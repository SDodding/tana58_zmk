## boards/shields/Tana58/Kconfig.defconfig
```kconfig
if SHIELD_TANA58_LEFT

config ZMK_KEYBOARD_NAME
    default "Tana58"

config ZMK_SPLIT_ROLE_CENTRAL
    default y

endif

if SHIELD_TANA58_LEFT || SHIELD_TANA58_RIGHT

config ZMK_SPLIT
    default y

endif
```

## boards/shields/Tana58/Kconfig.shield
```kconfig
config SHIELD_TANA58_LEFT
    def_bool $(shields_list_contains,tana58_left)

config SHIELD_TANA58_RIGHT
    def_bool $(shields_list_contains,tana58_right)
```
