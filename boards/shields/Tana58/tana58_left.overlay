#include "tana58.dtsi"

&kscan0 {
    col-gpios
        = <&pro_micro 9 GPIO_ACTIVE_HIGH> // col6 in the schematic
        , <&pro_micro 8 GPIO_ACTIVE_HIGH> // col7 in the schematic
        , <&pro_micro 7 GPIO_ACTIVE_HIGH> // col8 in the schematic
        , <&pro_micro 6 GPIO_ACTIVE_HIGH> // col9 in the schematic
        , <&pro_micro 5 GPIO_ACTIVE_HIGH> // col10 in the schematic
        , <&pro_micro 4 GPIO_ACTIVE_HIGH> // col11 in the schematic
        ;
};
